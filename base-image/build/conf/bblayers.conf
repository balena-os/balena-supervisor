## base-image/build/conf/bblayers.conf
```bitbake
# LAYER_CONF_VERSION is increased each time build/conf/bblayers.conf
# changes incompatibly
LCONF_VERSION = "7"

BBPATH = "${TOPDIR}"
BBFILES ?= ""

BBLAYERS ?= " \
  ${TOPDIR}/../oe-core/meta \
  ${TOPDIR}/../meta-oe/meta-oe \
  ${TOPDIR}/../meta-resin-supervisor \
  "
```

## base-image/build/conf/machine/generic-armv5.conf
```bitbake
#@TYPE: Machine
#@NAME: Generic armv5te machine
#@DESCRIPTION: Machine configuration for armv5te based boards

require conf/machine/include/arm/arch-armv5.inc

DEFAULTTUNE = "armv5t-vfp"
```

## base-image/build/conf/machine/generic-armv6.conf
```bitbake
#@TYPE: Machine
#@NAME: Generic armv6 machine
#@DESCRIPTION: Machine configuration for armv6 based boards

require conf/machine/include/arm/arch-armv6.inc

DEFAULTTUNE = "armv6thf"
```

## base-image/build/conf/machine/generic-armv7hf.conf
```bitbake
#@TYPE: Machine
#@NAME: Generic armv7a hard float machine
#@DESCRIPTION: Machine configuration for armv7a based boards

require conf/machine/include/arm/arch-armv7a.inc

DEFAULTTUNE = "armv7athf-vfpv3d16"
```

## base-image/build/conf/machine/generic-armv8.conf
```bitbake
#@TYPE: Machine
#@NAME: Generic armv8 machine
#@DESCRIPTION: Machine configuration for armv8 based boards

require conf/machine/include/arm/arch-armv8.inc

DEFAULTTUNE = "aarch64"
```

## base-image/build/conf/machine/generic-x86-64.conf
```bitbake
#@TYPE: Machine
#@NAME: common_pc
#@DESCRIPTION: Machine configuration for running a common x86

DEFAULTTUNE ?= "core2-64"
require conf/machine/include/tune-core2.inc
```

## base-image/build/conf/machine/generic-x86.conf
```bitbake
#@TYPE: Machine
#@NAME: common_pc
#@DESCRIPTION: Machine configuration for running a common x86

require conf/machine/include/tune-i586.inc
```

## base-image/build/conf/machine/i386-nlp.conf
```bitbake
#@TYPE: Machine
#@NAME: common_pc
#@DESCRIPTION: Machine configuration for x86 with quark cpu boards.

require conf/machine/include/tune-i586-nlp.inc
```

## base-image/meta-resin-supervisor/conf/layer.conf
```bitbake
BBPATH .= ":${LAYERDIR}"

BBFILES += "${LAYERDIR}/recipes-*/*/*.bb \
            ${LAYERDIR}/recipes-*/*/*.bbappend"

BBFILE_COLLECTIONS += "resin-supervisor"
BBFILE_PATTERN_resin-supervisor := "^${LAYERDIR}/"
BBFILE_PRIORITY_resin-supervisor = "1337"
```
